## board/myir/myc-rzt2h/Kconfig
```kconfig
if TARGET_MYC_RZT2H

config SYS_SOC
	default "rmobile"

config SYS_BOARD
	default "myc-rzt2h"

config SYS_VENDOR
	default "myir"

config SYS_CONFIG_NAME
	default "myc-rzt2h"

endif
```
